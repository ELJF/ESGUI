## example/SIFLI/ESGUI/project/build_sf32lb52-core_n16r16_hcpu/Kconfig
```kconfig
source "$SIFLI_SDK/Kconfig.v2"
source "$SIFLI_SDK/customer/boards/Kconfig.v2"
source "D:/SiFli/SiFli-SDK/v2.4.6/customer/boards/sf32lb52-core_n16r16/hcpu/Kconfig.board"
source "E:/bian_cheng/dan_pian_ji/STM/UI/ESGUI_Git/example/SIFLI/ESGUI/project/Kconfig.proj"
```

## example/SIFLI/ESGUI/project/build_sf32lb52-nano_n16r16_hcpu/Kconfig
```kconfig
source "$SIFLI_SDK/Kconfig.v2"
source "$SIFLI_SDK/customer/boards/Kconfig.v2"
source "D:/SiFli/SiFli-SDK/v2.4.6/customer/boards/sf32lb52-nano_n16r16/hcpu/Kconfig.board"
source "E:/bian_cheng/dan_pian_ji/SIFLI/CX/ESGUI/project/Kconfig.proj"
```

## example/SIFLI/ESGUI/project/build_sf32lb52-nano_n16r16_hcpu/bootloader/Kconfig
```kconfig
source "$SIFLI_SDK/Kconfig.v2"
source "$SIFLI_SDK/customer/boards/Kconfig.v2"
source "D:/SiFli/SiFli-SDK/v2.4.6/customer/boards/sf32lb52-nano_n16r16/hcpu/Kconfig.board"
source "D:/SiFli/SiFli-SDK/v2.4.6/example/boot_loader/project/butterflmicro/ram_v2/Kconfig.proj"
```

## example/SIFLI/ESGUI/project/build_sf32lb52-nano_n16r16_hcpu/ftab/Kconfig
```kconfig
source "$SIFLI_SDK/Kconfig.v2"
source "$SIFLI_SDK/customer/boards/Kconfig.v2"
source "D:/SiFli/SiFli-SDK/v2.4.6/customer/boards/sf32lb52-nano_n16r16/hcpu/Kconfig.board"
source "D:/SiFli/SiFli-SDK/v2.4.6/example/flash_table/sf32lb52x_common_v2/Kconfig.proj"
```
